#include <Arduino.h>
#define size 8
#define DELAY 300


short led_pins[] = {2, 3, 4, 5, 6, 7, 8, 9, 10, 11, 12, 13, A0, A1, A2, A3};

short rows[] = {8, 9, 10, 11, A0, A1, A2, A3};//{10, 7, 6, A2, 4, A1, 12, 13};
short columns[] = {0, 1, 2, 3, 4, 5, 6, 7};//{5, 8, 3, 9, A0, 2, 11, A3};
byte state = 0;

typedef byte screen_matrix[size];

short count = 0;

byte anim_length = 16; // animation: 31, heart_anim: 16

const screen_matrix heart PROGMEM = {0x99, 0x00, 0x00, 0x00, 0x81, 0xC3, 0xE7, 0xFF};
const screen_matrix random_cucc PROGMEM = {0x21, 0x71, 0xA8, 0xD5, 0x82, 0x43, 0x82, 0x76};
const screen_matrix animation[] PROGMEM = {
    {0xff, 0xff, 0xff, 0xff, 0xff, 0xff, 0xff, 0xff}, // demó effekt
    {0x7f, 0xff, 0xff, 0xff, 0xff, 0xff, 0xff, 0xfe},
    {0xbf, 0x7f, 0xff, 0xff, 0xff, 0xff, 0xfe, 0xfd},
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    {0xff, 0xff, 0xff, 0xff, 0xff, 0xff, 0xff, 0xff}
};

const screen_matrix heart_anim[] PROGMEM = {
    {0xff, 0x7f, 0x7f, 0x7f, 0xff, 0xff, 0xff, 0xff},
    {0x7f, 0x3f, 0x3f, 0x3f, 0x7f, 0xff, 0xff, 0xff},
    {0x3f, 0x1f, 0x1f, 0x1f, 0x3f, 0x7f, 0xff, 0xff},
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    {0xff, 0xff, 0xff, 0xff, 0xff, 0xff, 0xff, 0xff}
};

const screen_matrix *picture;


void refresh_screen() {
    for (byte row = 0; row < size; row++) {
        digitalWrite(rows[row], HIGH);
        byte current_row = pgm_read_byte_near(*picture + row);
        // Itt jó lenne egy portra írás, de összevissza vannak a lábak...
        PORTD = current_row;
       /*
       for (byte column = 0; column < size; column++) {
            // digitalWrite(columns[column], (*picture)[row]>>column)&0x01);
            digitalWrite(columns[column], (current_row >> column)&0x01);
            digitalWrite(columns[column], HIGH);
        }
        */
        delay(DELAY);
        PORTD = 0xFF;
        digitalWrite(rows[row], LOW);
    }
}


void setup() {
    for (byte i = 0; i < size; i++) {
        pinMode(rows[i], OUTPUT);
        digitalWrite(rows[i], LOW);
        pinMode(columns[i], OUTPUT);
        digitalWrite(columns[i], HIGH);
    }
    picture = &heart_anim[0];
    DDRD = 0xFF;
}

void loop() {
    refresh_screen();
    count++;
    if (count == 1500 - 5 * DELAY + 1) {
        count = 0;
        state++;
        if (state == anim_length){
            state = 0;
        }
        picture = &heart_anim[state];
    }
}
